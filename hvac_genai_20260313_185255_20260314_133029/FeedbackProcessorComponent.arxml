AUTOSAR XML (schema 4.0)
package /FeedbackProcessorComponent
  application software component type FeedbackProcessor
    require port ADCFeedbackPort: provided-interface=FeedbackInterface
    internal behavior FeedbackProcessorBehavior
      runnable UpdateFeedback
