AUTOSAR XML (schema 4.0)
package /LEDStatusComponent
  application software component type LEDStatus
    provide port LEDControlPort: required-interface=LEDControlInterface
    internal behavior LEDStatusBehavior
      runnable UpdateLEDStatus
