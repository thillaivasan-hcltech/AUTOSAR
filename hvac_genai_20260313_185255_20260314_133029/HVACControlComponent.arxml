AUTOSAR XML (schema 4.0)
package /HVACControlComponent
  application software component type HVACControl
    provide port FeedbackPort: required-interface=FeedbackInterface
    require port CommandPort: provided-interface=CommandInterface
    internal behavior HVACControlBehavior
      runnable ProcessCommands
      runnable UpdateFeedback
