AUTOSAR XML (schema 4.0)
package /MotorDriverComponent
  application software component type MotorDriver
    provide port MotorControlPort: required-interface=MotorControlInterface
    internal behavior MotorDriverBehavior
      runnable DriveMotor
      runnable StopMotor
